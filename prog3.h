// Original library and code base - https://github.com/mrfaptastic/ESP32-HUB75-MatrixPanel-I2S-DMA
#include <ESP32-HUB75-MatrixPanel-I2S-DMA.h>
#include <bits/stdc++.h> 
using namespace std;

// This grid might need to be changed depending on how your panels are setup. Here, it is left POV side panel = left half of grid.

int grid[n][128] = {{1, 1, 1, 1, 1, 0, 0, 0, 0, 0, 0, 0, 0,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 1, 1}, 
{1, 1, 1, 1, 0, 0, 0, 0, 0, 0, 0, 0, 0,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 1, 1}, 
{0, 0, 0, 0, 0, 0, 0, 0, 0, 0, 0, 0, 0,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 0, 0}, 
{0, 0, 0, 0, 0, 0, 0, 0, 0, 0, 0, 0, 0,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 0, 0}, 
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{0, 0, 0, 0, 0, 0, 0, 0, 0, 0, 0, 0, 0,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 0, 0}};

uint16_t col[n][m * chain];

void disp() { // Boolean array is threshold. Displays color grid masked by bitmask
  for (int i = 0; i < n; i++) {
    for (int j = 0; j < m * chain; j++) {
      if (grid[i][j]) matrixpanel->drawPixel(j, i, col[i][j]);
      else matrixpanel->drawPixel(j, i, matrixpanel->color565(0, 0, 0));
    }
  }
}

double rng() { // Random uniform distribution
  return rand() / (RAND_MAX + 1.0);
}

double runif(double a, double b) { // Random uniform [a, b)
  return (rng() * (b - a)) + a;
}

uint16_t protogen() { // Random hex color
  return matrixpanel->color565((int)runif(0, 256), (int)runif(0, 256), (int)runif(0, 256));
}

uint16_t protogenfullhue() { // Random color with full saturation and value
  int red = 0;
  int green = 0;
  int blue = 0;
  int partition = (int)runif(0, 255);
  int pos = (int)runif(0, 6);
  switch (pos) {
    case 0:
      return matrixpanel->color565(255, partition, 0);
    case 1:
      return matrixpanel->color565(255 - partition, 255, 0);
    case 2:
      return matrixpanel->color565(0, 255, partition);
    case 3:
      return matrixpanel->color565(0, 255 - partition, 255);
    case 4:
      return matrixpanel->color565(partition, 0, 255);
    default:
      return matrixpanel->color565(255, 255 - partition, 0);
  }
}

void prog3_setup() {
  srand(abs(hallRead()));
  Serial.begin(9600);
  // put your setup code here, to run once:
  HUB75_I2S_CFG mxconfig(m, n, chain, _pins);

  mxconfig.gpio.e = 18;
  mxconfig.clkphase = false;
  mxconfig.driver = HUB75_I2S_CFG::FM6126A;

  // Display Setup
  matrixpanel = new MatrixPanel_I2S_DMA(mxconfig);
  matrixpanel->setLatBlanking(2);
  matrixpanel->begin();
  matrixpanel->clearScreen();
  matrixpanel->setBrightness8(64);

  matrixpanel->fillScreenRGB888(255, 255, 255);
  delay(100);
  matrixpanel->drawRect(0, 0, 10, 10, matrixpanel->color565(0, 0, 0));
  delay(100);

  for (int i = 0; i < n; i++) {
    for (int j = 0; j < m * chain; j++) col[i][j] = matrixpanel->color565(255, 255, 255);
  }

  disp();
}

void prog3_loop() {
  uint16_t color = protogenfullhue();
  color = matrixpanel->color565(255, 255, 255);
  for (int i = 0; i < n; i++) {
    for (int j = 0; j < m * chain; j++) col[i][j] = color;
  }
  delay(100);
  Serial.println(rand() % 1024);
  disp();
}
